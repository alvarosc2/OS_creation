ENTRY(_start)

SECTIONS {
    . = 0x7E00;  /* Second sector location */

    .text : {
        *(.text*)
    }

    .rodata : {
        *(.rodata*)
    }

    .data : {
        *(.data*)
    }

    .bss : {
        *(.bss*)
        *(COMMON)
    }
}